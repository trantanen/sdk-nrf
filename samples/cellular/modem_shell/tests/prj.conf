## CMakeLists.txt
```
#
# Copyright (c) 2021 Nordic Semiconductor
#
# SPDX-License-Identifier: LicenseRef-Nordic-5-Clause
#

cmake_minimum_required(VERSION 3.13.1)

find_package(Zephyr REQUIRED HINTS $ENV{ZEPHYR_BASE})
project(modem_shell_test)

FILE(GLOB app_sources
	../../../../samples/cellular/modem_shell/src/shell.c
	../../../../samples/cellular/modem_shell/src/at/at_shell.c
	../../../../samples/cellular/modem_shell/src/main.c
	../../../../samples/cellular/modem_shell/src/utils/mosh_print.c
	../../../../samples/cellular/modem_shell/src/uart/uart.c
	../../../../samples/cellular/modem_shell/src/uart/uart_shell.c
	)
target_sources(app PRIVATE ${app_sources})

# generate runner for the test
test_runner_generate(src/modem_shell_test.c)

target_include_directories(app PRIVATE
	src
	../../../../samples/cellular/modem_shell/src
	../../../../samples/cellular/modem_shell/src/utils
	../../../../samples/cellular/modem_shell/src/at
	)

cmock_handle(${ZEPHYR_NRF_MODULE_DIR}/include/modem/lte_lc.h)
cmock_handle(${ZEPHYR_NRFXLIB_MODULE_DIR}/nrf_modem/include/nrf_modem_at.h
	     FUNC_EXCLUDE ".*nrf_modem_at_printf"
             FUNC_EXCLUDE ".*nrf_modem_at_scanf")

# When mocking nrf_modem_at then nrf_modem/include must manually be added
# because CONFIG_NRF_MODEM_LINK_BINARY=n
zephyr_include_directories(${ZEPHYR_NRFXLIB_MODULE_DIR}/nrf_modem/include/)
#zephyr_include_directories(${ZEPHYR_NRF_MODULE_DIR}/../modules/hal/nordic/nrfx)

# add test file
target_sources(app PRIVATE src/modem_shell_test.c)
```

## Kconfig
```
#
# Copyright (c) 2021 Nordic Semiconductor ASA
#
# SPDX-License-Identifier: LicenseRef-Nordic-5-Clause
#

config AT_NOTIF
	bool "Internal"
	default y
	help
	  Used in tests to enable mocking of AT Command library, i.e., remove
	  dependency from AT Command Notifications library to AT command library

menu "Zephyr Kernel"
rsource "../Kconfig"
#source "Kconfig.zephyr"
endmenu
```

## prj.conf
```kconfig
#
# Copyright (c) 2021 Nordic Semiconductor ASA
#
# SPDX-License-Identifier: LicenseRef-Nordic-5-Clause
#

CONFIG_UNITY=y
#CONFIG_RING_BUFFER=n
#CONFIG_ASSERT=y
#CONFIG_HEAP_MEM_POOL_SIZE=5120

CONFIG_MOSH_IPERF3=n
CONFIG_MOSH_SOCK=n
CONFIG_MOSH_PING=n
CONFIG_MOSH_CURL=n
CONFIG_MOSH_LINK=n
CONFIG_MOSH_SMS=n
CONFIG_MOSH_FOTA=n
CONFIG_MOSH_GNSS=n
CONFIG_MOSH_LOCATION=n
CONFIG_MOSH_REST=n
CONFIG_MOSH_CLOUD_REST=n
CONFIG_MOSH_CLOUD_MQTT=n
CONFIG_MOSH_AT_CMD_MODE=n

CONFIG_MOCK_NRF_MODEM_AT=y

# By default Low Noise Amplifier (LNA) is not enabled, generally this should be enabled if the
# on board GPS antenna is used. The LNA can also be controlled using shell commands.
#CONFIG_MOSH_GNSS_ENABLE_LNA=y

# Stacks and heaps
CONFIG_MAIN_STACK_SIZE=4096
CONFIG_HEAP_MEM_POOL_SIZE=10240
# System queue is used by LTE connection and many other parts
CONFIG_SYSTEM_WORKQUEUE_STACK_SIZE=8192

# Shell configurations
CONFIG_SHELL=y
CONFIG_SHELL_BACKEND_DUMMY=y
#CONFIG_SHELL_BACKEND_SERIAL=y
CONFIG_SHELL_WILDCARD=n
CONFIG_SHELL_PROMPT_UART="mosh:~$ "
CONFIG_SHELL_ARGC_MAX=16
# Command line buffer is set this large to enable writing of certificates.
CONFIG_SHELL_CMD_BUFF_SIZE=3072
# Shell stack has impact for modem shell application, not CONFIG_MAIN_STACK_SIZE
CONFIG_SHELL_STACK_SIZE=16384
CONFIG_LOG=n
#CONFIG_LOG2_MODE_DEFERRED=y
#CONFIG_MOSH_LOG_LEVEL_DBG=y
#CONFIG_LOG_STRDUP_MAX_STRING=94
#CONFIG_LOG_STRDUP_BUF_COUNT=6
#CONFIG_LOG_BLOCK_IN_THREAD=y
#CONFIG_LOG_BLOCK_IN_THREAD_TIMEOUT_MS=5000
#CONFIG_LOG_BUFFER_SIZE=16384

CONFIG_CBPRINTF_LIBC_SUBSTS=y
CONFIG_MINIMAL_LIBC=n
CONFIG_NEWLIB_LIBC=y
CONFIG_NEWLIB_LIBC_FLOAT_SCANF=n
CONFIG_NEWLIB_LIBC_FLOAT_PRINTF=y
CONFIG_FPU=n
CONFIG_CJSON_LIB=y

# Getopt
CONFIG_GETOPT_LIB=n # CHANGE

# Device power management
CONFIG_PM_DEVICE=y

# Library for buttons and LEDs
CONFIG_DK_LIBRARY=n

# Modem info
#CONFIG_MODEM_INFO=y

# Modem key management
#CONFIG_MODEM_KEY_MGMT=y

# Network
#CONFIG_NETWORKING=y
#CONFIG_NET_NATIVE=n
#CONFIG_NET_SOCKETS=y
#CONFIG_NET_SOCKETS_OFFLOAD=y
#CONFIG_NET_SOCKETS_POSIX_NAMES=n

CONFIG_POSIX_API=y # CHANGE
#CONFIG_PTHREAD_IPC=n # There are issues with posix api if this is set
#CONFIG_POSIX_MAX_FDS=10
# Need to be the same as MAX_FDS
#CONFIG_NET_SOCKETS_POLL_MAX=10

# Modem library
CONFIG_NRF_MODEM_LIB=n
#CONFIG_NRF_MODEM_LIB_SYS_INIT=n
#CONFIG_NRF_MODEM_LIB_SHMEM_TX_SIZE=16384
#CONFIG_NRF_MODEM_LIB_SHMEM_RX_SIZE=8192
# Enable modem UART traces
#CONFIG_NRF_MODEM_LIB_TRACE_ENABLED=n

CONFIG_AT_MONITOR=y

# PDN library
#CONFIG_PDN=y
#CONFIG_PDN_CONTEXTS_MAX=11

# AT commands
#CONFIG_AT_CMD=y
#CONFIG_AT_CMD_THREAD_STACK_SIZE=2048
#CONFIG_AT_NOTIF=y

# SMS
#CONFIG_SMS=y

# LTE link control
#CONFIG_LTE_LINK_CONTROL=y
#CONFIG_LTE_NETWORK_DEFAULT=y
#CONFIG_LTE_MODE_PREFERENCE_AUTO=y

#CONFIG_LTE_AUTO_INIT_AND_CONNECT=n
#CONFIG_LTE_NETWORK_USE_FALLBACK=n

#MOSH is having own commands to enable these at runtime:
#CONFIG_LTE_LC_MODEM_SLEEP_NOTIFICATIONS=n
#CONFIG_LTE_LC_TAU_PRE_WARNING_NOTIFICATIONS=n

#Minimum values for thresholds:
#CONFIG_LTE_LC_TAU_PRE_WARNING_THRESHOLD_MS=10240
#CONFIG_LTE_LC_MODEM_SLEEP_NOTIFICATIONS_THRESHOLD_MS=10240

# Configurations useful for debugging and development that user can enable when needed
#CONFIG_LTE_LOCK_PLMN=y
#CONFIG_LTE_LOCK_PLMN_STRING="24488"
#CONFIG_LTE_NETWORK_MODE_LTE_M_GPS=y

# GNSS SUPL (AGPS) support, needs the nRF9160 SiP SUPL client library from nRF9160 DK product page
#CONFIG_SUPL_CLIENT_LIB=n

# Enable this to use GNSS socket API instead of the GNSS interface.
#CONFIG_MOSH_GNSS_SOCKET=y

# Configurations for the GPS driver, enable these to use GPS driver instead of the GNSS interface.
#CONFIG_MOSH_GNSS_GPS_DRIVER=y

# Library for buttons and LEDs
#CONFIG_DK_LIBRARY=y

#CONFIG_NRF9160_GPS=y
#CONFIG_NRF9160_GPS_NMEA_GSV=y
#CONFIG_NRF9160_GPS_NMEA_GSA=y
#CONFIG_NRF9160_GPS_NMEA_GLL=y
#CONFIG_NRF9160_GPS_NMEA_GGA=y
#CONFIG_NRF9160_GPS_NMEA_RMC=y
# Enable if an external GPS antenna is used with the GPS driver.
#CONFIG_NRF9160_GPS_ANTENNA_EXTERNAL=y

# FOTA
#CONFIG_FLASH=y
#CONFIG_REBOOT=y
#CONFIG_DFU_TARGET=y
#CONFIG_FOTA_DOWNLOAD=y
#CONFIG_DOWNLOAD_CLIENT=y
# BOOTLOADER_MCUBOOT reduces usable flash size by half so it's disabled by default
# This means application FOTA is disabled. Modem FOTA works without these.
#CONFIG_BOOTLOADER_MCUBOOT=n
#CONFIG_IMG_MANAGER=n
#CONFIG_IMG_ERASE_PROGRESSIVELY=n

# Debugging configurations
#CONFIG_FLASH=y
#CONFIG_FLASH_MAP=y
#CONFIG_MPU_ALLOW_FLASH_WRITE=y
#CONFIG_NVS=y
#CONFIG_SETTINGS=y
#CONFIG_SETTINGS_NVS=y
#CONFIG_NVS_LOG_LEVEL_WRN=y

#CONFIG_ASSERT=y
#CONFIG_DEBUG_INFO=y
#CONFIG_ASSERT_VERBOSE=y
#CONFIG_RESET_ON_FATAL_ERROR=n
#CONFIG_EXTRA_EXCEPTION_INFO=n # CHANGED
```

## src/modem_shell_test.c
```c
/*
 * Copyright (c) 2021 Nordic Semiconductor ASA
 *
 * SPDX-License-Identifier: LicenseRef-Nordic-5-Clause
 */
#include <unity.h>
#include <stdbool.h>
#include <stdlib.h>
#include <string.h>
#include <zephyr/kernel.h>
#include <zephyr/device.h>

#include <zephyr/shell/shell.h>
#include <mock_nrf_modem_at.h>
#include <cmock_lte_lc.h>

void setUp(void)
{
	mock_nrf_modem_at_Init();
}

void tearDown(void)
{
	mock_nrf_modem_at_Verify();
}

static void mosh_execute_cmd(const char *cmd, int result)
{
	int ret;

	ret = shell_execute_cmd(NULL, cmd);

	printf("shell_execute_cmd(%s): %d\n", cmd, ret);

	TEST_ASSERT_EQUAL(result, ret);
}

void test_cmd_shell(void)
{
	mosh_execute_cmd("shell colors off", 0);
	mosh_execute_cmd("shell colors on", 0);
}

void test_cmd_at(void)
{
	static const char at_resp[] = "OK";

	mosh_execute_cmd("shell colors off", 0);
	mosh_execute_cmd("shell colors on", 0);

	__cmock_nrf_modem_at_cmd_ExpectAndReturn(NULL, 0, "%s", 0);
	__cmock_nrf_modem_at_cmd_IgnoreArg_buf();
	__cmock_nrf_modem_at_cmd_IgnoreArg_len();
	__cmock_nrf_modem_at_cmd_ReturnArrayThruPtr_buf((char *)at_resp, sizeof(at_resp));
	mosh_execute_cmd("at at", 0);

	mosh_execute_cmd("at", 0);
}

/* It is required to be added to each test. That is because unity is using
 * different main signature (returns int) and zephyr expects main which does
 * not return value.
 */
extern int unity_main(void);

/* This is needed because AT Monitor library is initialized in SYS_INIT. */
static int mosh_test_sys_init(const struct device *unused)
{
	__cmock_nrf_modem_at_notif_handler_set_ExpectAnyArgsAndReturn(0);

	return 0;
}

void main(void)
{
	printk("BEFORE MOSH START\n");

	__cmock_lte_lc_init_ExpectAndReturn(0);
	start_main();

	printk("TESTS START\n");
	(void)unity_main();
	printk("TESTS END\n");
}

SYS_INIT(mosh_test_sys_init, POST_KERNEL, 0);
```
