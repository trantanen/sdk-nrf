## samples/cellular/modem_shell/tests/testcase.yaml
```yaml
tests:
  samples.cellular.modem_shell.tests:
    platform_allow: nrf9160dk_nrf9160_ns nrf9161dk_nrf9161_ns
    integration_platforms:
      - nrf9160dk_nrf9160_ns
      - nrf9161dk_nrf9161_ns
    tags: modem_shell_test
```
